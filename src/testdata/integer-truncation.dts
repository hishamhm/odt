/dts-v1/;

/*
 * 12 cases to check:
 *
 * upper lost bits  |  lowest lost bit  |  highest kept bit  |  result
 * -------------------------------------------------------------------
 *               0  |                0  |                 0  |    okay
 *               0  |                0  |                 1  |    okay
 *               0  |                1  |                 0  |    warn
 *               0  |                1  |                 1  |    warn
 *           mixed  |                0  |                 0  |    warn
 *           mixed  |                0  |                 1  |    warn
 *           mixed  |                1  |                 0  |    warn
 *           mixed  |                1  |                 1  |    warn
 *               1  |                0  |                 0  |    warn
 *               1  |                0  |                 1  |    warn
 *               1  |                1  |                 0  |    okay
 *               1  |                1  |                 1  |    okay
 */

/ {
  8 = /bits/ 8 <
    0x0000000000000000
    0x00000000000000ff
    0x000000000000010e
    0x00000000000001fe
    0xa0a0a0a0a0a0a00e
    0xa0a0a0a0a0a0a0fe
    0xa0a0a0a0a0a0a10e
    0xa0a0a0a0a0a0a1fe
    0xfffffffffffffe0e
    0xfffffffffffffefe
    0xffffffffffffff00
    0xffffffffffffffff
  >;
  16 = /bits/ 16 <
    0x0000000000000000
    0x000000000000ffff
    0x000000000001000e
    0x000000000001fffe
    0xa0a0a0a0a0a0000e
    0xa0a0a0a0a0a0fffe
    0xa0a0a0a0a0a1000e
    0xa0a0a0a0a0a1fffe
    0xfffffffffffe000e
    0xfffffffffffefffe
    0xffffffffffff0000
    0xffffffffffffffff
  >;
  32 = /bits/ 32 <
    0x0000000000000000
    0x00000000ffffffff
    0x000000010000000e
    0x00000001fffffffe
    0xa0a0a0a00000000e
    0xa0a0a0a0fffffffe
    0xa0a0a0a10000000e
    0xa0a0a0a1fffffffe
    0xfffffffe0000000e
    0xfffffffefffffffe
    0xffffffff00000000
    0xffffffffffffffff
  >;
  64 = /bits/ 64 <
    0x0000000000000000
    0x000000000000000f
    0x7000000000000000
    0x700000000000000f
    0x8000000000000000
    0x800000000000000f
    0xf000000000000000
    0xf00000000000000f
  >;
};
